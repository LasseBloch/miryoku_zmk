// Copyright 2022 Manna Harbour
// https://github.com/manna-harbour/miryoku

#include "../miryoku/custom_config.h"
#include "../miryoku/mapping/40/dactyl_manuform_4x5_3.h"
#include "../miryoku/miryoku.dtsi"
